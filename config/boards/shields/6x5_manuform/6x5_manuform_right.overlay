// 6x5_manuform_right.overlay

#include "6x5_manuform.dtsi"

&default_transform {
    col-offset = <5>;
};

&kscan0 {
    col-gpios
        = ttrttttttttttttttttttttttttttttttttttttttttttttttttt<&xiao_d 9 GPIO_ACTIVE_HIGH>
        , <&xiao_d 8 GPIO_ACTIVE_HIGH>
        , <&xiao_d 7 GPIO_ACTIVE_HIGH>
        , <&xiao_d 6 GPIO_ACTIVE_HIGH>
        , <&xiao_d 5 GPIO_ACTIVE_HIGH>
        ;
};
